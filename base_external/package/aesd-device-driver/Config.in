## base_external/package/aesd-device-driver/Config.in
```kconfig
config BR2_PACKAGE_AESD_CHAR_DRIVER
	bool "aesd-device-driver"
   depends on BR2_LINUX_KERNEL
	help
	  Loading of aesd char device driver modules
```
